/*
 * display.c
 *
 *  Created on: Nov 25, 2021
 *      Author: adityasehgal
 */

#include <stdio.h>

#include "cmsis_os.h"
#include "display.h"
#include "analog.h"
#include "power.h"

#define	INFO_X 2
#define ON_OFF_X 105
#define	VIN_Y 0
#define	VSET_Y 12
#define	VOUT_Y 24
#define	ISET_Y 36
#define	IOUT_Y 48

#define INFO_TEXT_SIZE Font_7x10
#define ERROR_TEXT_SIZE Font_11x18

osThreadId oledTask_Handle;

const uint8_t BOOTSCREEN[] = { 0x00, 0x00, 0x00, 0x00, 0x00, 0x00, 0x00, 0x00,
		0x00, 0x00, 0x00, 0x00, 0x00, 0x00, 0x00, 0x00, 0x00, 0x00, 0x00, 0x00,
		0x00, 0x00, 0x00, 0x00, 0x00, 0x00, 0x00, 0x00, 0x00, 0x00, 0x00, 0x00,
		0x00, 0x00, 0x00, 0x00, 0x00, 0x00, 0x00, 0x00, 0x00, 0x00, 0x00, 0x00,
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		0x00, 0x00, 0x00, 0x00, 0x00, 0x00, 0x00, 0x00, 0x00, 0x00, 0x00, 0x00 };

static void oledTask(void const *argument);

static uint32_t calcVSetFromPot(uint8_t pot);

static void setupVin(stats_t stats);

static void setupVset(stats_t stats);

static void setupVout(stats_t stats);

static void setupIset(stats_t stats);

static void setupIout(stats_t stats);

static void setupOnOff(stats_t stats);

static void display_startUpScreen(void);

void oledTask(void const *argument) {
	ssd1306_init();
	display_startUpScreen();
	osDelay(2000);
	stats_t stats;

	for (;;) {

		analog_updateStats(&stats);
		power_updateStats(&stats);
		display_showStats(stats);
		osDelay(100);
	}

	osThreadTerminate(osThreadGetId());
}

uint32_t calcVSetFromPot(uint8_t pot) {

	double potCalc = (((double) pot / 128.0)) * 5000.0;
	double temp = 800.0 * ((5000.0 / potCalc) + 1.0);
	return (uint32_t) (temp);

}

void setupVin(stats_t stats) {

	char buff[10] = { };

	//Display voltage in
	ssd1306_setCursor(INFO_X, VIN_Y);
	ssd1306_writeString("Vin  = ", INFO_TEXT_SIZE, SSD1306_WHITE);
	if (stats.Vin > 1000) {
		sprintf(buff, "%4.2f", stats.Vin / 1000);
		ssd1306_writeString(buff, INFO_TEXT_SIZE, SSD1306_WHITE);
		ssd1306_writeString("V", INFO_TEXT_SIZE, SSD1306_WHITE);
	} else {
		sprintf(buff, "%4.2f", stats.Vin);
		ssd1306_writeString(buff, INFO_TEXT_SIZE, SSD1306_WHITE);
		ssd1306_writeString("mV", INFO_TEXT_SIZE, SSD1306_WHITE);
	}

}

void setupVset(stats_t stats) {
	char buff[10] = { };
	//display set voltage
	ssd1306_setCursor(INFO_X, VSET_Y);
	ssd1306_writeString("Vset = ", INFO_TEXT_SIZE, SSD1306_WHITE);

	uint32_t vSet = calcVSetFromPot(stats.vSet);

	if (vSet >= 1000) {
		sprintf(buff, "%4.2f", (double) vSet / 1000.0);
		ssd1306_writeString(buff, INFO_TEXT_SIZE, SSD1306_WHITE);
		if (stats.selVI == VI_V_SEL)
			ssd1306_writeString("V <<", INFO_TEXT_SIZE, SSD1306_WHITE);
		else
			ssd1306_writeString("V     ", INFO_TEXT_SIZE, SSD1306_WHITE);
	} else {
		sprintf(buff, "%4.2f", (double) vSet);
		ssd1306_writeString(buff, INFO_TEXT_SIZE, SSD1306_WHITE);
		if (stats.selVI == VI_V_SEL)
			ssd1306_writeString("mV <<", INFO_TEXT_SIZE, SSD1306_WHITE);
		else
			ssd1306_writeString("mV     ", INFO_TEXT_SIZE, SSD1306_WHITE);
	}
}

void setupVout(stats_t stats) {
	char buff[10] = { };
	//display output voltage
	ssd1306_setCursor(INFO_X, VOUT_Y);
	ssd1306_writeString("Vout = ", INFO_TEXT_SIZE, SSD1306_WHITE);
	if (stats.Vout >= 1000) {
		sprintf(buff, "%4.2f", stats.Vout / 1000.0);
		ssd1306_writeString(buff, INFO_TEXT_SIZE, SSD1306_WHITE);
		ssd1306_writeString("V", INFO_TEXT_SIZE, SSD1306_WHITE);
	} else {
		sprintf(buff, "%4.2f", stats.Vout);
		ssd1306_writeString(buff, INFO_TEXT_SIZE, SSD1306_WHITE);
		ssd1306_writeString("mV", INFO_TEXT_SIZE, SSD1306_WHITE);
	}
}

void setupIset(stats_t stats) {
	char buff[10] = { };
	//display set current
	ssd1306_setCursor(INFO_X, ISET_Y);
	ssd1306_writeString("Iset = ", INFO_TEXT_SIZE, SSD1306_WHITE);
	if (stats.iSet >= 1000) {
		sprintf(buff, "%4.2f", (double) stats.iSet / 1000.0);
		ssd1306_writeString(buff, INFO_TEXT_SIZE, SSD1306_WHITE);
		if (stats.selVI == VI_I_SEL)
			ssd1306_writeString("A <<", INFO_TEXT_SIZE, SSD1306_WHITE);
		else
			ssd1306_writeString("A     ", INFO_TEXT_SIZE, SSD1306_WHITE);
	} else {
		sprintf(buff, "%4.2f", (double) stats.iSet);
		ssd1306_writeString(buff, INFO_TEXT_SIZE, SSD1306_WHITE);
		if (stats.selVI == VI_I_SEL)
			ssd1306_writeString("mA <<", INFO_TEXT_SIZE, SSD1306_WHITE);
		else
			ssd1306_writeString("mA     ", INFO_TEXT_SIZE, SSD1306_WHITE);
	}
}

void setupIout(stats_t stats) {
	char buff[10] = { };
	//display output current
	ssd1306_setCursor(INFO_X, IOUT_Y);
	ssd1306_writeString("Iout = ", INFO_TEXT_SIZE, SSD1306_WHITE);
	if (stats.Iout >= 1000) {
		sprintf(buff, "%4.2f", stats.Iout / 1000.0);
		ssd1306_writeString(buff, INFO_TEXT_SIZE, SSD1306_WHITE);
		ssd1306_writeString("A", INFO_TEXT_SIZE, SSD1306_WHITE);
	} else {
		sprintf(buff, "%4.2f", stats.Iout);
		ssd1306_writeString(buff, INFO_TEXT_SIZE, SSD1306_WHITE);
		ssd1306_writeString("mA", INFO_TEXT_SIZE, SSD1306_WHITE);
	}
}

void setupOnOff(stats_t stats) {
	//display whether PSU output is enabled
	ssd1306_setCursor(ON_OFF_X, VIN_Y);
	if (stats.outputEn == OE_ENABLED)
		ssd1306_writeString("ON   ", INFO_TEXT_SIZE, SSD1306_WHITE);
	else
		ssd1306_writeString("OFF", INFO_TEXT_SIZE, SSD1306_WHITE);
}

void display_startUpScreen(void) {
	ssd1306_drawBitMap(0, 0, BOOTSCREEN, 128, 32, SSD1306_WHITE);
	ssd1306_updateScreen();
}

void display_init(void) {
	osThreadDef(oledTask_, oledTask, osPriorityNormal, 0, 512);
	oledTask_Handle = osThreadCreate(osThread(oledTask_), NULL);
}

void display_writeErrorMsg(int16_t x, int16_t y, char *str) {

}

void display_showStats(stats_t stats) {
	ssd1306_fill(SSD1306_BLACK);
	setupVin(stats);
	setupVout(stats);
	setupVset(stats);
	setupIout(stats);
	setupIset(stats);
	setupOnOff(stats);

	ssd1306_updateScreen();
}

